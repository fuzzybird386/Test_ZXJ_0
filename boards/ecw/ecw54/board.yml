## boards/ecw/ecw54/board.yml
```yaml
board:
  name: ecw54
  full_name: Single electrode ECW nRF54L15
  vendor: ecw
  socs:
    - name: nrf54l15
```

## boards/local/ecw54/Kconfig.ecw54
```kconfig
config BOARD_ECW54
    select SOC_NRF54L15_CPUAPP if BOARD_ECW54_NRF54L15_CPUAPP
```

## boards/local/ecw54/board.yml
```yaml
board:
  name: ecw54
  full_name: ECW single channel nRF54L15
  vendor: local
  socs:
    - name: nrf54l15
```
